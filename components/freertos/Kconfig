## components/net/espmesh/Kconfig
```kconfig
menu "MTK3 ESP-MESH"

config ESPMESH_CHANNEL
    int "Mesh WiFi channel"
    default 6
    range 1 13
    help
        All nodes in the mesh must use the same channel.  1/6/11 overlap
        least with BLE advertising channels if BLE coexists later.

config ESPMESH_MAX_LAYER
    int "Max mesh layer (tree depth)"
    default 2
    range 1 25

config ESPMESH_AP_PASSWORD
    string "Mesh inter-node AP password"
    default "mtk3mesh1"

config ESPMESH_ROUTER_SSID
    string "Upstream router SSID"
    default "YOUR_ROUTER_SSID"
    help
        Set this to your own WiFi network before building the ESP-MESH
        examples.  The root node associates to this router; a non-root node
        must carry the same router config even when it reaches the network
        only through its mesh parent.

        Note ESPMESH_CHANNEL must match this router's actual WiFi channel -
        the mesh child does not scan or switch channels.

config ESPMESH_ROUTER_PASSWORD
    string "Upstream router password"
    default ""
    help
        Your router's WPA2 password.  Left empty by default so the value is
        never carried in the repository; set it with
        `idf.py -C examples/ble_espmesh_root menuconfig` under "MTK3 ESP-MESH",
        or edit the example's sdkconfig.defaults locally.

endmenu
```

## main/Kconfig.projbuild
```kconfig
menu "µT-Kernel 3.0 Feature Set"

choice MTK3_FEATURE_SET
    prompt "Feature set"
    default MTK3_KERNEL_ONLY
    help
        Select which feature set to compile. Each option adds stack components
        on top of the µT-Kernel core. Load the matching sdkconfig defaults
        file when first configuring a new build:

          Kernel only      : idf.py build
          Kernel + WiFi    : idf.py -DSDKCONFIG_DEFAULTS="sdkconfig.defaults.wifi" build
          Kernel + BLE     : idf.py -DSDKCONFIG_DEFAULTS="sdkconfig.defaults.ble" build
          Kernel + WiFi+BLE: idf.py -DSDKCONFIG_DEFAULTS="sdkconfig.defaults.wifi_ble" build

config MTK3_KERNEL_ONLY
    bool "Kernel only"
    help
        Minimal build: µT-Kernel scheduler, IPC primitives, cyclic handlers,
        timers, and device drivers (serial, ADC, I2C). Smallest flash
        footprint (~300 KB).

config MTK3_KERNEL_WIFI
    bool "Kernel + WiFi"
    help
        Adds WiFi (esp_wifi), lwIP TCP/IP stack, esp_netif, and ESP-MESH.
        Requires sdkconfig.defaults.wifi for IDF-level defaults.

config MTK3_KERNEL_BLE
    bool "Kernel + BLE (NimBLE)"
    help
        Adds Bluetooth Low Energy via the NimBLE host stack (peripheral,
        central, observer, and broadcaster roles). Requires
        sdkconfig.defaults.ble for IDF-level defaults.

config MTK3_KERNEL_WIFI_BLE
    bool "Kernel + WiFi + BLE [EXPERIMENTAL]"
    help
        Enables simultaneous WiFi and BLE with hardware coexistence (HW CCA).

        WARNING: This combination is not yet fully stable. Occasional resets
        may occur under heavy simultaneous WiFi + BLE traffic. Intended for
        evaluation and development only — not recommended for production.

        Requires sdkconfig.defaults.wifi_ble for IDF-level defaults.

endchoice

config MTK3_WIFI_ENABLED
    bool
    default y if MTK3_KERNEL_WIFI || MTK3_KERNEL_WIFI_BLE

config MTK3_BLE_ENABLED
    bool
    default y if MTK3_KERNEL_BLE || MTK3_KERNEL_WIFI_BLE

endmenu
```

## sdkconfig.defaults.wifi
```kconfig
# Kernel + WiFi
# Usage: idf.py -DSDKCONFIG_DEFAULTS="sdkconfig.defaults.wifi" build
CONFIG_IDF_TARGET="esp32c3"
CONFIG_ESP_MAIN_TASK_STACK_SIZE=4096
CONFIG_ESPTOOLPY_FLASHSIZE_4MB=y
CONFIG_ESP_CONSOLE_USB_SERIAL_JTAG=y
# CONFIG_ESP_CONSOLE_UART_DEFAULT is not set
CONFIG_ESP_CONSOLE_SECONDARY_NONE=y

CONFIG_MTK3_KERNEL_WIFI=y
CONFIG_LWIP_ENABLE=y
```
